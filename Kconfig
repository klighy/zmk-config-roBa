## Kconfig
```kconfig
rsource "drivers/pmw3610/Kconfig"

config ZMK_HID_LAYER_STATE_REPORT
    bool "Layer State HID Report"
    depends on !ZMK_SPLIT || ZMK_SPLIT_ROLE_CENTRAL
    help
      Send the highest active layer and lock state using HID input report 0x04.
```

## config/west.yml
```yaml
manifest:
  remotes:
    - name: zmkfirmware
      url-base: https://github.com/zmkfirmware
    - name: ykiewang
      url-base: https://github.com/ykiewang
  projects:
    - name: zmk
      remote: zmkfirmware
      revision: v0.3-branch
      import: app/west.yml
    - name: zmk-keybeacon
      remote: ykiewang
      revision: v1.2.0
  self:
    path: config
```
